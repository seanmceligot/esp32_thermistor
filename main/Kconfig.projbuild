## main/Kconfig.projbuild
```kconfig
menu "Wifi Configuration"

    config ESP_WIFI_SSID
        string "WiFi SSID"
        default "myssid"
        help
            SSID (network name) for the example to connect to.

    config ESP_WIFI_PASSWORD
        string "WiFi Password"
        default "mypassword"
        help
            WiFi password (WPA or WPA2) for the example to use.
    
    config ESP_MQTT_URL
        string "MQTT URL"
        default "mqtt://192.168.1.2"
        help
            MQTT URL

    config ESP_MQTT_USERNAME
        string "MQTT USERNAME"
        default "user"
        help
            MQTT USERNAME

    config ESP_MQTT_PASSWORD
        string "MQTT PASSWORD"
        default "secret"
        help
            MQTT PASSWORD

    config ESP_MAXIMUM_RETRY
        int "Maximum retry"
        default 5
        help
            Set the Maximum retry to avoid station reconnecting to the AP unlimited when the AP is really inexistent.
endmenu
```
